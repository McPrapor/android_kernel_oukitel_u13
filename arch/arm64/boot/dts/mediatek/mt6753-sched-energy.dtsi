energy-costs {
	CPU_COST_0: core-cost0 {
		busy-cost-data = <
			184    48
			266    66
			378   115
			419   137
			450   156
			532   217
			573   251
			593   273
		>;
		idle-cost-data = <
			  0
		>;
	};
	CLUSTER_COST_0: cluster-cost0 {
		busy-cost-data = <
			184    74
			266   104
			378   151
			419   168
			450   181
			532   220
			573   238
			593   250
		>;
		idle-cost-data = <
			 110
			 105
		>;
	};
};
